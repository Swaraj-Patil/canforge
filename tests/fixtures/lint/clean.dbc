// expect: none
VERSION "1.0"
BU_: A B
BO_ 100 Msg: 8 A
 SG_ X : 0|8@1+ (1,0) [0|255] "" B
 SG_ Y : 15|8@0- (0.5,-10) [-74|53.5] "V" B
