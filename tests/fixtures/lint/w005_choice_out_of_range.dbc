// expect: W005
VERSION ""
BU_: A B
BO_ 100 Msg: 8 A
 SG_ X : 0|2@1+ (1,0) [0|3] "" B
VAL_ 100 X 0 "Off" 1 "On" 7 "Impossible" ;
