// expect: E004, E004
VERSION ""
BU_: A B
BO_ 100 Msg: 8 A
 SG_ X : 0|8@1+ (1,0) [0|255] "" B
 SG_ X : 8|8@1+ (1,0) [0|255] "" B
BO_ 101 Msg: 8 A
 SG_ Z : 0|8@1+ (1,0) [0|255] "" B
