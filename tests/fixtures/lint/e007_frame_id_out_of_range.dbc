// expect: E007
VERSION ""
BU_: A B
BO_ 2048 Msg: 8 A
 SG_ X : 0|8@1+ (1,0) [0|255] "" B
