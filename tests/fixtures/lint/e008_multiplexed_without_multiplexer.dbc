// expect: E008
VERSION ""
BU_: A B
BO_ 100 Msg: 8 A
 SG_ X m1 : 8|8@1+ (1,0) [0|255] "" B
