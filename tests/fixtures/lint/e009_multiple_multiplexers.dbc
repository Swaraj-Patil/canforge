// expect: E009
VERSION ""
BU_: A B
BO_ 100 Msg: 8 A
 SG_ First M : 0|4@1+ (1,0) [0|15] "" B
 SG_ Second M : 4|4@1+ (1,0) [0|15] "" B
