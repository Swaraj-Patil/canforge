// expect: E006, E006
VERSION ""
BU_: A B
BO_ 100 Msg: 8 A
 SG_ Empty : 0|0@1+ (1,0) [0|0] "" B
 SG_ Huge : 0|65@1+ (1,0) [0|0] "" B
