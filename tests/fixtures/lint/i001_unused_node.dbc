// expect: I001
VERSION ""
BU_: A B C
BO_ 100 Msg: 8 A
 SG_ X : 0|8@1+ (1,0) [0|255] "" B
