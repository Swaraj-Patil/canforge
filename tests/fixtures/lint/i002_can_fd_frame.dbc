// expect: I002
VERSION ""
BU_: A B
BO_ 100 Msg: 64 A
 SG_ X : 0|8@1+ (1,0) [0|255] "" B
